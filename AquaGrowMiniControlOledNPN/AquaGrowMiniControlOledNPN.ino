/*
  AquaGrow Programmcode zur Steuerung von Aquarien
  Copyright (C)2013-2015 AquaGrow - Moritz Stapelfeldt. All right reserved
  
  Der Code wurde entwickelt um Aquarien zu automatisieren und zu steuern. Er ist frei zugänglich und unterliegt dem Gedanken des OpenSource. Jeder kann ihn kostenfrei verwenden, kopieren, ganz oder teilweise solange die verwendeten Codezeilen als Fremdcode Kenntlich gemacht wurden und ein Link zum Orginal und/oder zur Webseite http://www.Aqua-Grow.de erhalten bleibt.
  
  Ich, als Urheber des Quellcodes übernehme keine Garantie auf die funktion des Quellcodes im ganzen oder teilen. Für evt Bugfixes und Updates besuche bitte http://www.Aqua-Grow.de und/oder https://github.com/majormadness
  
  Wenn veränderungen, modifikationen und/oder verbesserungen am Code vorgenommen werden bitte Ich um mitteilung unter info@aqua-grow.de

  This Software is free software; you can redistribute it and/or modify it under the terms of the CC BY-NC-SA 3.0 license.

  Commercial use of this Software requires you to buy a license that will allow commercial use. This includes using the Software, modified or not, as a tool to sell products.

  The license applies to all part of the Software including the examples and tools supplied with the Software.
*/

#include <Wire.h>
#include <RTClib.h>
#include <PCA9685.h>
#include <avr/pgmspace.h>
#include <Timer.h>
#include <OneWire.h>
#include <MemoryFree.h>
#include <Keypad.h>  
#include <Keypad_I2C.h>  
#include <EEPROM.h>
#include "writeAnything.h" 
#include "structs.h"
#include "config.h"

#include <MicroLCD.h>
LCD_SSD1306 lcd; 

//#include <LiquidCrystal_I2C.h>
//#define LCD_ADR 0x27      // Adresse LCD
//LiquidCrystal_I2C lcd(LCD_ADR,2,1,0,4,5,6,7,3,POSITIVE);   // Set the LCD I2C address

Timer t;
RTC_DS1307 rtc;
PCA9685 ledDriver; 
OneWire  ds(PIN_TEMP);
boolean pumpReset=false;


boolean manualLight=false;
float temperatur;
unsigned long last_print = 0;
String inputString = "";
boolean stringComplete = false;


const uint16_t pwmtable[] PROGMEM= 0,2,4,7,9,11,13,15,18,20,22,24,26,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4095,4095};

 
const byte ROWS = 4; //four rows
const byte COLS = 4; //four columns
//define the cymbols on the buttons of the keypads
char keys[ROWS][COLS] = {
  {'1','2','3','A'},
  {'4','5','6','B'},
  {'7','8','9','C'},
  {'*','0','#','D'}
};
byte rowPins[ROWS] = {0, 1, 2, 3}; //connect to the row pinouts of the keypad
byte colPins[COLS] = {4, 5, 6, 7}; //connect to the column pinouts of the keypad

//char holdKey;
unsigned long t_hold;

//initialize an instance of class NewKeypad
Keypad_I2C keypad = Keypad_I2C( makeKeymap(keys), rowPins, colPins, ROWS, COLS, KEYPADI2C );


void setup() {

  Wire.begin();
  rtc.begin();
  keypad.begin( );  
  keypad.addEventListener(keypadEvent); // Add an event listener for this keypad
  
  
  Serial.begin(9600);

  ledDriver.begin(LED_DRV);
  ledDriver.init(true);
  lcd.begin();
    lcd.setCursor(0,0); 
    lcd.print(F("AquaGrow MiniControl"));
  for (int i=0;i<=PUMPCOUNTS;i++){
    pinMode(dosing[i].pinAddr, OUTPUT);
  }
  inputString.reserve(20);
  
}

void loop() {
  rtc.now();
  t.update();
  char key = keypad.getKey();
  
//  if (key) {
//    Serial.println(key);
//  }
 
/*
      if (keypad.getState() == HOLD && key && (millis() - t_hold) > 500 ) {
        Serial.println(key);
        if(key=='A'||key=='B'||key=='C'||key=='D'||key=='#'||key=='*'){
      }else{
        Serial.print(F(" keySWITCH1"));
        t_hold = millis();
        switch_holdKey(key);
      }
    } 
*/
  // print the string when a newline arrives:
  if (stringComplete) {
    serialHandler(inputString);
    inputString = "";
    stringComplete = false;
  }

      // Licht Dimmen
    if(!manualLight){
      setLight();
    }
  if (millis() - last_print > 1000) {
    last_print = millis();
    
    Serial.println(retTime());
//    Serial.println(freeMemory());
    
    setDosing();
    
    temperatur = getTemp();
    if(coolingTemp+2.0 < temperatur){
        analogWrite(PIN_PWM,pwmValue);
    }else if(coolingTemp-2.0 > temperatur){
        analogWrite(PIN_PWM,0);
    }
    
    printTime();
    printTemp(temperatur);

  }            
}

float getTemp(){
  byte present = 0;
  byte data[12];
  byte addr[8];
  ds.search(addr);
      
  ds.reset();
  ds.select(addr);
  ds.write(0x44, 1);
  present = ds.reset();
  ds.select(addr);    
  ds.write(0xBE); 
  for (byte i = 0; i < 9; i++) {
    data[i] = ds.read();
  }
  int16_t raw = (data[1] << 8) | data[0];
  
  return (float)raw / 16.0; //celsius;
}
